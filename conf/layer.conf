## conf/layer.conf
```bitbake
# We have a conf and classes directory, add to BBPATH
BBPATH .= ":${LAYERDIR}"

# We have recipes-* directories, add to BBFILES
BBFILES += "${LAYERDIR}/recipes-*/*/*.bb \
            ${LAYERDIR}/recipes-*/*/*.bbappend"

BBFILE_COLLECTIONS += "meta-mangopi-robot"
BBFILE_PATTERN_meta-mangopi-robot = "^${LAYERDIR}/"
BBFILE_PRIORITY_meta-mangopi-robot = "6"

LAYERDEPENDS_meta-mangopi-robot = "core"
LAYERSERIES_COMPAT_meta-mangopi-robot = "dunfell"
```
